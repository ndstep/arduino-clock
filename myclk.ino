#define BLINKER_BLE

#include <DS3231.h>
#include <Wire.h>
#include <LedControl.h>
#include <Blinker.h>

int Buzzer = 4;
int DIN = 5;
int CS = 6;
int CLK = 7;
int lyl;
int secnum = 0;
int sec8num = 0;
int inte = 3;
bool Century = false;
bool h12;
bool PM;
bool isShutdown = false;
byte year, month, date, DoW, hour, minute, second;
byte heart1[8] = {0x00, 0x66, 0xFF, 0xFF, 0x7E, 0x3C, 0x18, 0x00};
byte heart2[8] = {0x00, 0x00, 0x24, 0x7E, 0x3C, 0x18, 0x00, 0x00};
byte numb[][7] = {
	{0x18, 0x24, 0x24, 0x24, 0x24, 0x24, 0x18}, /*"0",0*/
	{0x08, 0x18, 0x08, 0x08, 0x08, 0x08, 0x18}, /*"1",1*/
	{0x18, 0x24, 0x04, 0x08, 0x10, 0x20, 0x3C}, /*"2",2*/
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	{0x18, 0x24, 0x24, 0x1C, 0x04, 0x24, 0x18}, /*"9",9*/
};
byte alph[][7] = {
	{0x30, 0x48, 0x48, 0x48, 0x78, 0x48, 0x48}, /*"A",0*/
	{0x70, 0x48, 0x48, 0x70, 0x48, 0x48, 0x70}, /*"B",1*/
	{0x30, 0x48, 0x40, 0x40, 0x40, 0x48, 0x30}, /*"C",2*/
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	{0x78, 0x08, 0x10, 0x30, 0x20, 0x40, 0x78}, /*"Z",25*/
};
byte showSec[9] = {0x80, 0x40, 0x20, 0x10, 0x08, 0x04, 0x02, 0x01, 0x00};

DS3231 Clock;
LedControl lc = LedControl(DIN, CLK, CS, 4);
BlinkerButton btn_shutdown("btn-shutdown");
BlinkerButton btn_reset("btn-reset");
BlinkerSlider ran_inte("ran-inte");
BlinkerTab Tab1("tab-ned");

void (*resetFunc)(void) = 0;

void beepBegin()
{
	digitalWrite(Buzzer, HIGH);
}

void beepEnd(){
	digitalWrite(Buzzer, LOW);
}

void printByte(int num, byte character[])
{
	int i = 0;
	for (i = 1; i < 8; i++)
	{
		lc.setRow(num, i, character[i - 1]);
	}
}

void uiUpdate()
{
	ran_inte.print(inte);
	if (isShutdown)
		btn_shutdown.color("red");
	else
		btn_shutdown.color("green");
	btn_shutdown.print();
}
void dispHour(int dsn = 0)
{
	hour = Clock.getHour(h12, PM);
	printByte(dsn, numb[hour / 10]);
	printByte(dsn + 1, numb[hour % 10]);
}

void dispMins(int dsn = 2)
{
	minute = Clock.getMinute();
	printByte(dsn, numb[minute / 10]);
	printByte(dsn + 1, numb[minute % 10]);
}

void dispYear()
{
	year = Clock.getYear();
	printByte(0, numb[2]);
	printByte(1, numb[0]);
	printByte(2, numb[year / 10]);
	printByte(3, numb[year % 10]);
	Serial.print(year);
}

void btn_shutdown_callback(const String &state)
{
	BLINKER_LOG("get button state: ", state);
	if (state == "tap")
	{
		isShutdown = !isShutdown;
		BLINKER_LOG("shutdown state: ", isShutdown);

		for (int i = 0; i < 4; i++)
		{
			lc.shutdown(i, isShutdown);
		}
		if (isShutdown)
			btn_shutdown.color("red");
		else
			btn_shutdown.color("green");

		btn_shutdown.print();
	}
}



void btn_reset_callback(const String &state)
{

	if (state == "tap" && !isShutdown)
	{
		resetFunc();
		BLINKER_LOG("reset state: ", state);
	}
}

void ran_inte_callback(int32_t value)
{
	//digitalWrite(LED_BUILTIN, !digitalRead(LED_BUILTIN));
	BLINKER_LOG("get slider value: ", value);
	inte = value;
	for (int i = 0; i < 4; i++)
	{
		lc.setIntensity(i, value);
	}
}

void dataRead(const String &data)
{
	BLINKER_LOG("Blinker readString: ", data);
	if (data == "+CONNECTED")
	{
		uiUpdate();
	}
}

void prtSec()
{

	if (sec8num == 8)
	{
		lc.setRow(secnum, 0, showSec[sec8num]);
		sec8num = 0;
		secnum++;
		if (secnum > 3)
			secnum = 0;
	}
	lc.setRow(secnum, 0, showSec[sec8num]);
	sec8num++;
}

void setup()
{
	pinMode(Buzzer, OUTPUT);
	Serial.begin(115200);
	BLINKER_DEBUG.stream(Serial);
	uiUpdate();

	for (int i = 0; i < 4; i++)
	{
		lc.shutdown(i, false); //启动时，MAX72XX处于省电模式
		lc.setIntensity(i, 2); //将亮度设置为最大值
		lc.clearDisplay(i);	   //清除显示
	}
	Wire.begin();
	Blinker.begin();
	Blinker.attachData(dataRead);
	btn_shutdown.attach(btn_shutdown_callback);
	btn_reset.attach(btn_reset_callback);
	ran_inte.attach(ran_inte_callback);
}

void loop()
{
	Blinker.run();
	dispMins();
	dispHour();
	//dispYear();
	prtSec();
	delay(200);
}
